## build/conf/bblayers.conf
```bitbake
# POKY_BBLAYERS_CONF_VERSION is increased each time build/conf/bblayers.conf
# changes incompatibly
POKY_BBLAYERS_CONF_VERSION = "2"

BBPATH = "${TOPDIR}"
BBFILES ?= ""

BBLAYERS ?= " \
  /home/pramode/rpi-swupdate/layers/poky/meta \
  /home/pramode/rpi-swupdate/layers/poky/meta-poky \
  /home/pramode/rpi-swupdate/layers/poky/meta-yocto-bsp \
  /home/pramode/rpi-swupdate/layers/meta-openembedded/meta-oe \
  /home/pramode/rpi-swupdate/layers/meta-swupdate \
  /home/pramode/rpi-swupdate/layers/meta-swupdate-boards \
  /home/pramode/rpi-swupdate/layers/meta-openembedded/meta-python \
  /home/pramode/rpi-swupdate/layers/meta-openembedded/meta-networking \
  /home/pramode/rpi-swupdate/layers/meta-raspberrypi \
  "
```
